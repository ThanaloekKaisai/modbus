## main/Kconfig.projbuild
```kconfig
menu "Echo RS485 Example Configuration"

    orsource "$IDF_PATH/examples/common_components/env_caps/$IDF_TARGET/Kconfig.env_caps"

    config ECHO_UART_PORT_NUM
        int "UART port number"
        range 0 2 if IDF_TARGET_ESP32 || IDF_TARGET_ESP32S3
        default 2 if IDF_TARGET_ESP32 || IDF_TARGET_ESP32S3
        range 0 1
        default 1
        help
            UART communication port number for the example.

    config ECHO_UART_BAUD_RATE
        int "UART communication speed"
        range 1200 115200
        default 115200
        help
            UART communication speed for Modbus example.

    config ECHO_UART_RXD
        int "UART RXD pin number"
        range ENV_GPIO_RANGE_MIN ENV_GPIO_IN_RANGE_MAX
        default 16  # Set RX to GPIO16
        help
            GPIO number for UART RX pin.

    config ECHO_UART_TXD
        int "UART TXD pin number"
        range ENV_GPIO_RANGE_MIN ENV_GPIO_OUT_RANGE_MAX
        default 17  # Set TX to GPIO17
        help
            GPIO number for UART TX pin.

    config ECHO_UART_RTS
        int "UART RTS pin number"
        range ENV_GPIO_RANGE_MIN ENV_GPIO_OUT_RANGE_MAX
        default 33  # Set RTS to GPIO33
        help
            GPIO number for UART RTS pin. This pin is connected to ~RE/DE pin of RS485 transceiver.

    config ECHO_TASK_STACK_SIZE
        int "UART echo RS485 example task stack size"
        range 1024 16384
        default 3072
        help
            Defines stack size for UART echo RS485 example.

endmenu
```
